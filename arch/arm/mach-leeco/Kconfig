## arch/arm/mach-leeco/Kconfig
```kconfig
# Configuration menu for LeEco devices
menu "LeEco device configuration"

config MACH_LEECO
	bool "Kernel support for LeEco devices"
	depends on ARCH_MSM8996
	select USB_CCLOGIC
	select TOUCHSCREEN_SYNAPTICS_DSX_LETV
	select TOUCHSCREEN_SYNAPTICS_DSX_CORE_LETV
	select TOUCHSCREEN_SYNAPTICS_DSX_RMI_DEV_LETV
	select TOUCHSCREEN_SYNAPTICS_DSX_FW_UPDATE_LETV
	select TOUCHSCREEN_SYNAPTICS_DSX_TEST_REPORTING_LETV
	select MSM_I2C_FLASH
	select LETVS_CLASS
	default n
	help
	  Once selected, this will apply common Kernel changes
	  from LeEco at all levels. Device specific changes aren't
	  covered, you need to select them manually.

	  The following drivers will be selected in Kernel:

	  * USB CC Logic -> USB Type-C
	  * Synaptics DSX -> Touchscreen
	  * MSM I2C Flash -> Camera's Flash
	  * LeTV Class -> Probe Helper

	  This can be used to apply patches from LeEco without touching
	  other devices or the general purpose of the Linux Kernel.

	  If unsure, say N.

config MACH_LEECO_OEM
	depends on MACH_LEECO
	bool "OEM extensions for LeEco devices"
	help
	  Once selected, this option will bring-in OEM changes in Kernel source code, they
	  aren't usually needed.

	  If unsure, say Y here to avoid issues when running stock Android firmware. Otherwise,
	  say N.

config MACH_LEECO_DEBUG
	depends on MACH_LEECO
	bool "Debugging conditionals for LeEco devices"
	help
	  Once selected, this option will enable most OEM debugging code in Kernel, this is
	  not needed unless you're debugging changes on those OEM drivers.

	  If unsure, say N.

config MACH_LEECO_PD
	depends on MACH_LEECO
	select USB_CYCCG
	select QPNP_MHL
	bool "Support USB PD control protocol for LeEco devices"
	help
	  Once selected, this option will enable support for LeEco's PD infrastructure. This
	  new USB infrastructure is a dependency for some USB controllers like the ANX7418,
	  it will be available as 'le_ab' power supply type in SMB charger interface.

	  This will select the CYCCG USB driver as a dependency to poll temperature from the
	  USB controller.

	  If unsure, say N.

config MACH_LEECO_X2
	bool "Kernel support for the Le Max 2 (X2)"
	depends on MACH_LEECO
	select ANALOGIX_OHIO
	select BACKLIGHT_LM3697
	select DEEP_SLEEP_LED_SWITCH
	select INPUT_DRV2604L_HAPTICS
	select TOUCHKEY_ATMEGA48A_LETV
	select TOUCHSCREEN_ATMEL_MXT_LETV
	select TOUCHSCREEN_HIDEEP_TP_LETV
	select IR_MAXQ616
	select SND_SOC_ES9018
	select SND_SOC_TFA98XX
	select FB_MSM_MDSS_HDMI_MHL_SII6400
	select FB_MSM_MDSS_HDMI_DP_ANX7816
	help
	  Once selected, barebones Le Max 2 tuning and drivers will take effect.

	  The following drivers will be selected in Kernel:

	  * Analogix -> USB Type-C
	  * LM3697 -> Backlight
	  * TI DRV2604L -> Vibrator
	  * ATmega48A -> Capacitive Keys
	  * Atmel MXT -> Display Panel
	  * Hideep TP -> Panel Pressure Reporting
	  * MAXQ616 -> Infrared Remote Control
	  * ES9018 -> Hi-Fi Audio
	  * TFA98XX -> SmartPA Amplifier
	  * SII6400 -> USB-to-HDMI Peripheral
	  * ANX7816 -> Slimport Peripheral

	  OEM changes such as custom init, cpufreq modifications, VR support and proprietary
	  sound controllers aren't covered in this option.
	  Thus, if you want those OEM changes you'll need to select the next
	  option right down below.

	  If unsure, you're the expert. Otherwise, always say N.

config MACH_LEECO_X2_OEM
	depends on MACH_LEECO_X2
	bool "OEM extensions for the Le Max 2 (X2)"
	help
	  Once selected, this option will bring-in OEM changes in Kernel source code, they
	  aren't usually needed.

	  If unsure, say Y here to avoid issues when running stock Android firmware. Otherwise,
	  say N.

config MACH_LEECO_ZL1
	bool "Kernel support for the Le Pro 3 (ZL1)"
	depends on MACH_LEECO
	select BACKLIGHT_LM3697
	select INPUT_DRV2604L_HAPTICS
	select INPUT_GP5XX8
	select IR_MAXQ616
	select TOUCHSCREEN_FTS
	select SND_SOC_MAX98927
	select NFC_LETV
	help
	  Once selected, barebones Le Pro 3 tuning and drivers will take effect.

	  The following drivers will be selected in Kernel:

	  * LM3697 -> Backlight
	  * TI DRV2604L -> Vibrator
	  * Goodix 5208 -> Fingerprint Sensor
	  * MAXQ616 -> Infrared Remote Control
	  * Focaltech FTS -> Display Panel
	  * Maxim MAX98927 -> SmartPA Amplifier
	  * Custom ZL1 MBHC -> Audio Socket
	  * PN544 -> NFC

	  OEM changes such as custom init, cpufreq modifications, VR support and proprietary
	  sound controllers aren't covered in this option.
	  Thus, if you want those OEM changes you'll need to select the next
	  option right down below.

	  If unsure, you're the expert. Otherwise, always say N.

config MACH_LEECO_ZL1_OEM
	depends on MACH_LEECO_ZL1
	bool "OEM extensions for the Le Pro 3 (ZL1)"
	help
	  Once selected, this option will bring-in OEM changes in Kernel source code, they
	  aren't usually needed.

	  If unsure, say Y here to avoid issues when running stock Android firmware. Otherwise,
	  say N.

endmenu
```

## arch/arm64/mach-leeco/Kconfig
```kconfig
# LeTV/LeEco devices
config MACH_LEECO
	bool "Kernel support for LeEco (LeTV) devices"
	depends on ARCH_MSM8996
	select USB_CCLOGIC
	select USB_CYCCG
	select ANALOGIX_OHIO
	select LETVS_CLASS
	select TOUCHKEY_ATMEGA48A_LETV
	select TOUCHSCREEN_SYNAPTICS_DSX_LETV
	select MSM_I2C_FLASH
	select QPNP_MHL
	default n
	help
	  Once selected, this will apply common Kernel changes
	  from LeEco at all levels. Device specific changes aren't
	  covered, you need to select them manually.

	  The following drivers will be selected in Kernel:

	  * USB CC Logic -> USB Type-C
	  * USB Cypress -> USB Type-C
	  * Analogix -> USB Type-C
	  * ATmega48A -> Capacitive Keys
	  * QPNP MHL -> MHL State
	  * MSM I2C Flash -> Camera's Flash

	  This can be used to apply patches from LeEco without touching
	  other devices or the general purpose of the Linux Kernel.

	  If unsure, say N.

config MACH_LEECO_OEM
	depends on MACH_LEECO
	bool "OEM extensions for LeEco (LeTV) devices"
	help
	  Once selected, this option will bring-in OEM changes in Kernel source code, they
	  aren't usually needed.

	  If unsure, say Y here to avoid issues when running stock Android firmware. Otherwise,
	  say N.

config MACH_LEECO_DEBUG
	depends on MACH_LEECO
	bool "Debugging conditionals for LeEco (LeTV) devices"
	help
	  Once selected, this option will enable most OEM debugging code in Kernel, this is
	  not needed unless you're debugging changes on those OEM drivers.

	  If unsure, say N.

config MACH_LEECO_ZL1
	bool "Kernel support for the Le Pro 3 (ZL1)"
	depends on MACH_LEECO
	select BACKLIGHT_LM3697
	select INPUT_DRV2604L_HAPTICS
	select INPUT_GP5XX8
	select IR_MAXQ616
	select NFC_LETV
	select SND_SOC_MAX98927
	select SND_SOC_WCD_MBHC_ZL1
	select TOUCHSCREEN_FTS
	select TOUCHSCREEN_SYNAPTICS_DSX_CORE_LETV
	select TOUCHSCREEN_SYNAPTICS_DSX_RMI_DEV_LETV
	select TOUCHSCREEN_SYNAPTICS_DSX_FW_UPDATE_LETV
	select TOUCHSCREEN_SYNAPTICS_DSX_TEST_REPORTING_LETV
	select FB_MSM_MDSS_HDMI_DP_ANX7816
	help
	  Once selected, barebones Le Pro 3 tuning and drivers will take effect.

	  The following drivers will be selected in Kernel:

	  * LM3697 -> Backlight
	  * Goodix 5208 -> Fingerprint Sensor
	  * Focaltech FTS -> Touchsreen
	  * ANX7816 -> Slimport (Colorado 3)
	  * TI DRV2604L -> Vibrator
	  * MAXQ616 -> Infrared Remote Control
	  * Maxim MAX98927 -> Smart PA
	  * Custom ZL1 MBHC -> Audio Socket
	  * PN544 -> NFC

	  OEM changes such as custom init, cpufreq modifications, VR support and proprietary
	  sound controllers aren't covered in this option.
	  Thus, if you want those OEM changes you'll need to select the next
	  option right down below.

	  If unsure, you're the expert. Otherwise, always say N.

config MACH_LEECO_ZL1_OEM
	depends on MACH_LEECO_ZL1
	bool "OEM extensions for the Le Pro 3 (ZL1)"
	help
	  Once selected, this option will bring-in OEM changes in Kernel source code, they
	  aren't usually needed.

	  If unsure, say Y here to avoid issues when running stock Android firmware. Otherwise,
	  say N.

config SND_SOC_WCD_MBHC_ZL1
	depends on MACH_LEECO_ZL1
	tristate "Custom MBHC codec for the Le Pro 3 (ZL1)"
	help
	  Once selected, this will compile an alternative version of the
	  MBHC sound codec, specific for the Le Pro 3.

	  This option is automatically enabled when MACH_LEECO_ZL1 is selected.
```

## drivers/input/goodixfp/Kconfig
```kconfig
#
# Goodix fingerprint sensor
#
config INPUT_GP5XX8
	tristate "Goodix GP5XX8 driver support"
	depends on INPUT
	help
	  Say Y here if you want to support Goodix 5208
	  fingerprint sensor.

	  If unsure, say N.

config INPUT_GP5XX8_POCKET
	tristate "Goodix GP5XX8 pocket mode support"
	depends on INPUT_POCKET
	help
	  Say Y here if you want to support pocket mode
	  for the Goodix 5208 fingerprint sensor.

	  If unsure, say N.
```

## drivers/nfc/pn544_op/Kconfig
```kconfig
config NFC_PN544_OP
	tristate "PN544 NFC driver which is frozen from the OnePlus code drop"
	depends on I2C
	select CRC_CCITT
	default n
	---help---
	  Say yes if you want PN544 Near Field Communication driver by OnePlus.
	  This is for i2c connected version. If unsure, say N here.
```

## drivers/staging/qcacld-2.0/Kconfig
```kconfig
comment "Qualcomm Atheros CLD WLAN module"

config QCA_CLD_WLAN

	tristate "Qualcomm Atheros CLD WLAN module"
	default y
	help
	Add support for the Qualcomm Atheros CLD WLAN module

if QCA_CLD_WLAN != n

config QCACLD_WLAN_LFR3
	bool "Enable the WLAN Legacy Fast Roaming feature Version 3"
	default y

config PRIMA_WLAN_OKC
	bool "Enable the Prima WLAN Opportunistic Key Caching feature"
	default y

config PRIMA_WLAN_11AC_HIGH_TP
	bool "Enable the Prima WLAN 802.11ac High Throughput option (depends upon kernel support)"
	default y

config WLAN_FEATURE_11W
	bool "Enable the WLAN 802.11w Protected Management Frames feature"
	default y

config WLAN_FEATURE_LPSS
	bool "Enable the WLAN LPSS feature"
	default y

config QCOM_VOWIFI_11R
	bool "Enable Fast Transition (11r) feature"
	default y

config WLAN_FEATURE_NAN
	bool "Enable NAN feature"
	default y

config WLAN_FEATURE_NAN_DATAPATH
	bool "Enable NaN Data Path feature"
	depends on WLAN_FEATURE_NAN
	default y

config QCOM_TDLS
	bool "Enable TDLS feature"
	default y

config QCOM_LTE_COEX
	bool "Enable QCOM LTE Coex feature"
	default y

config WLAN_SYNC_TSF
	bool "Enable QCOM sync multi devices tsf feature"
	default n


config WLAN_OFFLOAD_PACKETS
	bool "Enable offload packets feature"
	default y

config QCA_WIFI_AUTOMOTIVE_CONC
	bool "Enable 3 port concurrency feature"
	default y

config WLAN_UDP_RESPONSE_OFFLOAD
	bool "Enable UDP response offload feature"
	default n

config WLAN_WOW_PULSE
	bool "Enable WOW Pulse feature"
	default n

config DPTRACE_ENABLE
	bool "Enable DPTRACE feature for non performance builds"
	default n

endif # QCA_CLD_WLAN
```

## drivers/usb/misc/anx7418/Kconfig
```kconfig
config ANALOGIX_OHIO
	tristate "Analogix Type-C interface support"
	select MACH_LEECO_PD
	help
	  Analogix Type-C interface chip support for USB PD protocol.

	  This option depends on the OEM PD protocol in SMB charger interface.

	  If unsure, say N.
```
